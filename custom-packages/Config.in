## custom-packages/Config.in
```kconfig
menu "Custom packages"

source "$BR2_EXTERNAL_CUSTOM_PACKAGES_PATH/package/adb/Config.in"
source "$BR2_EXTERNAL_CUSTOM_PACKAGES_PATH/package/fastboot/Config.in"

endmenu
```

## custom-packages/configs/aarch64_custom_defconfig
```kconfig
BR2_aarch64=y
BR2_TOOLCHAIN_BUILDROOT_UCLIBC=y
BR2_STATIC_LIBS=y
BR2_PACKAGE_ADB=y
BR2_PACKAGE_FASTBOOT=y
```

## custom-packages/package/adb/Config.in
```kconfig
config BR2_PACKAGE_ADB
    bool "adb"
    help
      Android Debug Bridge (static)
```

## custom-packages/package/fastboot/Config.in
```kconfig
config BR2_PACKAGE_FASTBOOT
    bool "fastboot"
    help
      Android Fastboot (static)
```
